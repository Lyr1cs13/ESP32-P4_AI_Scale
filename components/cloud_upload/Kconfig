## components/cloud_upload/Kconfig
```kconfig
menu "AI Scale Cloud Upload"

    config AI_SCALE_CLOUD_UPLOAD_ENABLED
        bool "Enable meal record cloud upload"
        default y

    if AI_SCALE_CLOUD_UPLOAD_ENABLED

        config AI_SCALE_CLOUD_WIFI_SSID
            string "Wi-Fi SSID"
            default ""

        config AI_SCALE_CLOUD_WIFI_PASSWORD
            string "Wi-Fi password"
            default ""

        config AI_SCALE_CLOUD_RECORD_URL
            string "Meal record API URL"
            default "http://106.53.198.194/api/v1/weigh-in/record"

        config AI_SCALE_CLOUD_USER_ID
            int "Cloud user ID"
            range 1 2147483647
            default 15

        config AI_SCALE_CLOUD_COOKING_TIME_MINUTES
            int "Default cooking time in minutes"
            range 0 1440
            default 10

        config AI_SCALE_CLOUD_RETRY_SECONDS
            int "Retry interval after upload failure"
            range 2 300
            default 10

    endif

endmenu
```

## components/perception/Kconfig.projbuild
```kconfig
menu "AI Scale Perception"

    config AI_SCALE_CAMERA_VIDEO_BUFFER_NUMBER
        int "Camera video buffer number"
        default 2
        range 2 4

    config AI_SCALE_HX711_SCALE
        int "HX711 scale factor"
        default 380

    config AI_SCALE_HX711_AVG_SAMPLES
        int "HX711 average samples"
        default 10
        range 1 20

    config AI_SCALE_WEIGHT_POLL_INTERVAL_MS
        int "Weight poll interval ms"
        default 100
        range 20 1000

    config AI_SCALE_WEIGHT_CHANGE_THRESHOLD_G
        int "Stable weight change threshold g"
        default 15
        range 1 1000

    config AI_SCALE_WEIGHT_STABLE_DELTA_G
        int "Stable weight window g"
        default 5
        range 1 100

    config AI_SCALE_WEIGHT_STABLE_COUNT
        int "Stable windows before capture"
        default 2
        range 1 10

    config AI_SCALE_TRIGGER_COOLDOWN_MS
        int "Weight trigger cooldown ms"
        default 2500
        range 200 10000

    config AI_SCALE_AI_CAPTURE_TIMEOUT_MS
        int "AI capture timeout ms"
        default 1000
        range 100 5000

endmenu
```

## main/Kconfig.projbuild
```kconfig
menu "AI Scale Run Mode"
    choice AI_SCALE_RUN_MODE
        prompt "Application run mode"
        default AI_SCALE_RUN_MODE_FULL
        help
            Select which subsystem starts after boot. This is used for staged
            bring-up before running the full one-board AI scale.

        config AI_SCALE_RUN_MODE_PERCEPTION_ONLY
            bool "Perception only: camera + HX711 + YOLO"
            help
                Start only the perception pipeline. Use this when validating
                food recognition and weight capture without the touch display.

        config AI_SCALE_RUN_MODE_DISPLAY_NUTRITION_ONLY
            bool "Display and nutrition only: touch UI + NutriCook"
            help
                Start only the LVGL UI and nutrition inference. Use serial
                input to simulate detected foods.

        config AI_SCALE_RUN_MODE_FULL
            bool "Full AI scale: perception + touch UI + NutriCook"
            help
                Start all subsystems and connect perception results to the UI.
    endchoice
endmenu

menu "DSI_DEMO Configuration"
    config EXAMPLE_USE_DMA2D_COPY_FRAME
        bool "Use DMA2D to copy draw buffer to frame buffer"
        default y
        help
            Enable this option, DMA2D will be used to copy the LVGL draw buffer to the target frame buffer.
            This can save some CPU time and improve the performance.

    config EXAMPLE_MONITOR_REFRESH_BY_GPIO
        bool "Monitor Refresh Rate by GPIO"
        default y
        help
            Enable this option, you can visualize the refresh rate by attaching a logic analyzer to a specific GPIO.
            The GPIO will output a square wave with the frequency equals to half of the refresh rate.

    config DISPLAY_READ_ID
    bool "Enable read id of LCD"
    default n 
    help
        Enable read id of LCD.

    choice   
        prompt "Select MIPI LCD color format"
        default DSI_LCD_COLOR_FORMAT_565
        help
            Select LCD color format.

        config DSI_LCD_COLOR_FORMAT_565
            bool "16b RGB565"
        config DSI_LCD_COLOR_FORMAT_888
            bool "24b RGB888"
    endchoice      



    choice
        prompt "Select MIPI LCD model"
        default INCH_2_8_LCD_ST7701S_480x640
        help
            Select LCD controller model.

        config INCH_2_8_LCD_ST7701S_480x640
            bool "2.8 inch LCD"
        config INCH_2_4_LCD_ST7701S_480x640
            bool "2.4 inch LCD"
        config INCH_4_0_LCD_RM69A10_568_1232
            bool "4.0 inch AMOLED"
        config INCH_10_0_LCD_JD9365_800_1280
            bool "10 inch lcd WX101BH020I-40Z"
    endchoice



endmenu
```

## sdkconfig.defaults
```kconfig
CONFIG_LV_CONF_SKIP=y
CONFIG_LV_COLOR_DEPTH_24=y
CONFIG_LV_FONT_MONTSERRAT_16=y
CONFIG_LV_FONT_MONTSERRAT_22=y
CONFIG_LV_FONT_MONTSERRAT_32=y
CONFIG_LV_USE_OBSERVER=y
CONFIG_IDF_EXPERIMENTAL_FEATURES=y
CONFIG_SPI_FLASH_SUPPORT_GD_CHIP=y
CONFIG_ESP_VIDEO_ENABLE_ISP_PIPELINE_CONTROLLER=y
CONFIG_ESP_VIDEO_ENABLE_MIPI_CSI_VIDEO_DEVICE=y
CONFIG_ESP_VIDEO_ENABLE_ISP_VIDEO_DEVICE=y
CONFIG_ESP_VIDEO_ENABLE_SWAP_BYTE=y
CONFIG_CAMERA_SC2336=y
CONFIG_CAMERA_SC2336_AUTO_DETECT_MIPI_INTERFACE_SENSOR=y
CONFIG_CAMERA_SC2336_MIPI_RAW8_1280X720_30FPS=y
CONFIG_EXAMPLE_SELECT_ESP32P4_FUNCTION_EV_BOARD_V1_5=y
```

## sdkconfig.defaults.esp32p4
```kconfig
CONFIG_SPIRAM=y
CONFIG_EXAMPLE_SCCB_I2C_INIT_BY_APP=y
CONFIG_AI_SCALE_RUN_MODE_FULL=y
CONFIG_SPIRAM_MODE_HEX=y
CONFIG_SPIRAM_SPEED_200M=y
CONFIG_SPI_FLASH_SUPPORT_GD_CHIP=y
CONFIG_ESPTOOLPY_FLASHSIZE_32MB=y
CONFIG_ESPTOOLPY_FLASHMODE_QIO=y
CONFIG_ESP32P4_SELECTS_REV_LESS_V3=y
CONFIG_ESP32P4_REV_MIN_1=y
CONFIG_PARTITION_TABLE_CUSTOM=y
CONFIG_PARTITION_TABLE_CUSTOM_FILENAME="partitions.csv"
CONFIG_PARTITION_TABLE_OFFSET=0x12000
CONFIG_LV_FONT_MONTSERRAT_22=y
CONFIG_LV_FONT_MONTSERRAT_32=y
CONFIG_CAMERA_SC2336=y
CONFIG_CAMERA_SC2336_AUTO_DETECT_MIPI_INTERFACE_SENSOR=y
CONFIG_CAMERA_SC2336_MIPI_RAW8_1280X720_30FPS=y
CONFIG_CAMERA_OV5647=y
CONFIG_CAMERA_OV5647_AUTO_DETECT_MIPI_INTERFACE_SENSOR=y
CONFIG_CAMERA_OV5647_MIPI_RAW10_1920X1080_30FPS=y
CONFIG_ESP_VIDEO_ENABLE_MIPI_CSI_VIDEO_DEVICE=y
CONFIG_ESP_VIDEO_ENABLE_ISP_VIDEO_DEVICE=y
CONFIG_ESP_VIDEO_ENABLE_ISP_PIPELINE_CONTROLLER=y
CONFIG_ESP_VIDEO_ENABLE_SWAP_BYTE=y
CONFIG_EXAMPLE_SELECT_ESP32P4_FUNCTION_EV_BOARD_V1_5=y
CONFIG_AI_SCALE_HX711_AVG_SAMPLES=2
CONFIG_AI_SCALE_WEIGHT_POLL_INTERVAL_MS=20
CONFIG_AI_SCALE_WEIGHT_STABLE_COUNT=2
CONFIG_AI_SCALE_TRIGGER_COOLDOWN_MS=500

# Board-mounted ESP32-C6 Wi-Fi coprocessor over SDIO.
CONFIG_SLAVE_IDF_TARGET_ESP32C6=y
CONFIG_ESP_HOSTED_ENABLED=y
CONFIG_ESP_HOSTED_CP_TARGET_ESP32C6=y
CONFIG_ESP_HOSTED_P4_DEV_BOARD_NONE=y
CONFIG_ESP_HOSTED_SDIO_HOST_INTERFACE=y
CONFIG_ESP_HOSTED_SDIO_SLOT_1=y
CONFIG_ESP_HOSTED_SDIO_SLOT=1
CONFIG_ESP_HOSTED_SDIO_4_BIT_BUS=y
CONFIG_ESP_HOSTED_SDIO_BUS_WIDTH=4
CONFIG_ESP_HOSTED_SDIO_CLOCK_FREQ_KHZ=40000
CONFIG_ESP_HOSTED_SDIO_PIN_CMD=19
CONFIG_ESP_HOSTED_SDIO_PIN_CLK=18
CONFIG_ESP_HOSTED_SDIO_PIN_D0=14
CONFIG_ESP_HOSTED_SDIO_PIN_D1=15
CONFIG_ESP_HOSTED_SDIO_PIN_D2=16
CONFIG_ESP_HOSTED_SDIO_PIN_D3=17
CONFIG_ESP_HOSTED_SDIO_GPIO_RESET_SLAVE=54
CONFIG_ESP_HOSTED_SLAVE_RESET_ON_EVERY_HOST_BOOTUP=y
CONFIG_ESP_HOSTED_TRANSPORT_RESTART_ON_FAILURE=y
CONFIG_ESP_WIFI_REMOTE_ENABLED=y
CONFIG_ESP_WIFI_REMOTE_LIBRARY_HOSTED=y

CONFIG_AI_SCALE_CLOUD_UPLOAD_ENABLED=y
CONFIG_AI_SCALE_CLOUD_WIFI_SSID="LYY"
CONFIG_AI_SCALE_CLOUD_WIFI_PASSWORD="wccc9556"
CONFIG_AI_SCALE_CLOUD_RECORD_URL="http://106.53.198.194/api/v1/weigh-in/record"
CONFIG_AI_SCALE_CLOUD_USER_ID=15
CONFIG_AI_SCALE_CLOUD_COOKING_TIME_MINUTES=10
CONFIG_AI_SCALE_CLOUD_RETRY_SECONDS=10
```
